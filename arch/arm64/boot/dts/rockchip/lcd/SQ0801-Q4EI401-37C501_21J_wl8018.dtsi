&dsi0 {
	status = "disabled";
	//rockchip,lane-rate = <1000>;
	
	dsi0_panel: panel@0 {
		status = "disabled";
		compatible = "simple-panel-dsi";
		reg = <0>;
		//backlight = <&backlight1>;
		
		prepare-delay-ms = <120>;
		reset-delay-ms = <120>;
		init-delay-ms = <120>;
		stbyb-delay-ms = <120>;
		enable-delay-ms = <120>;
		disable-delay-ms = <120>;
		unprepare-delay-ms = <120>;
		
		dsi,flags = <(MIPI_DSI_MODE_VIDEO | MIPI_DSI_MODE_VIDEO_BURST |
			MIPI_DSI_MODE_LPM | MIPI_DSI_MODE_EOT_PACKET)>;
		dsi,format = <MIPI_DSI_FMT_RGB888>;
		dsi,lanes  = <4>;
	
/*panel-init-sequence = [
		15 00 02 50 5A
                15 00 02 54 03
                39 00 03 50 5A 09
                39 00 11 80 5A 51 B5 2A 6C B5 4A 01 C0 E0 0D 82 20 08 30 03
                39 00 11 90 00 3F 42 0A E3 01 1B 71 F5 BE 7A 20 2D A1 26 00
                39 00 07 A0 01 80 08 20 06 00
                39 00 03 50 5A 0A
                39 00 11 80 B6 6D 03 00 0F 1C 2B 3C 4D 53 83 52 86 B6 87 A1
                39 00 11 90 72 6A 57 43 2F 1D 0B 00 0F 1C 2B 3C 4D 53 83 52
                39 00 0D A0 86 B6 87 A1 72 6A 57 43 2F 1D 0B 00
                39 00 03 50 5A 0B
                39 00 11 80 00 00 20 44 08 00 60 47 00 00 10 22 04 00 B0 23
                39 00 03 90 15 00
                39 00 03 50 5A 0C
                39 00 11 80 FA 68 90 01 28 69 68 06 00 60 15 00 50 15 56 51
                39 00 11 90 15 55 61 15 00 60 15 00 50 15 56 51 15 55 61 95
                39 00 11 A0 AB 18 00 05 00 05 00 05 80 4C 29 84 52 01 09 00
                39 00 03 50 5A 0D
                39 00 0F 80 F0 B1 71 EF 49 C0 80 1A 00 00 00 00 00 00
                39 00 06 39 00 03 50 5A 0E
                39 00 0D 80 FF 81 68 6C 22 6D 24 00 00 00 00 00
                39 00 03 50 5A 0F
                39 00 11 80 9D 0E 30 00 19 E0 63 0C 51 21 F8 50 01 66 8C 8C
                39 00 08 90 24 69 81 71 44 7C 14
                39 00 03 50 5A 10
                39 00 11 80 00 80 03 E7 1F 17 20 50 00 52 CD 18 30 88 41 8A
                39 00 10 90 39 28 A9 C5 9A 7B F0 07 7E E0 07 7E 20 10 00
                39 00 03 50 5A 11
                39 00 11 80 43 77 03 40 8A F1 FF 43 30 08 C1 46 A0 80 24 18
                39 00 11 90 30 06 64 C1 80 21 07 C4 E1 D0 68 40 20 1D 04 48
                39 00 11 A0 40 40 28 10 90 70 38 1A 10 47 03 E2 20 00 1C 80
                39 00 11 B0 50 30 00 E0 E1 01 00 28 0E 06 C3 C8 CC CC CC CC
                39 00 11 C0 8C 88 88 88 88 88 C8 08 86 C6 E3 81 00 20 00 21
                39 00 11 D0 42 88 00 00 00 00 40 00 00 31 04 41 06 00 00 00
                39 00 11 E0 00 92 24 49 92 04 00 00 00 00 00 00 00 85 11 0C
                39 00 0A F0 00 00 40 00 00 00 00 5E 00
                39 00 03 50 5A 12
                39 00 11 80 00 00 00 00 00 00 00 00 00 00 00 00 00 00 00 00
                39 00 0A 90 00 00 00 00 00 00 00 00 00
                39 00 03 50 5A 13
                39 00 11 80 01 00 00 0C 00 00 00 00 01 00 01 1C 44 0C CE E7
                39 00 04 90 62 06 00
                39 00 03 50 5A 14
                39 00 11 80 B1 01 40 5E E9 EF F7 FB FD 7E 00 00 00 44 C5 06
                39 00 11 90 DE 2D 20 2E F0 6E 01 1B 81 77 0B D8 0A BC 5B 00
                39 00 11 A0 38 FC 7E 08 CC E0 F7 43 00 00 00 00 00 00 00 00
                39 00 11 B0 00 00 00 00 00 00 00 00 00 84 28 88 2A 00 40 A1
                39 00 11 C0 50 78 03 78 B7 80 31 00 2F 00 EF 16 30 06 E0 15
                39 00 11 D0 E0 DD 02 C6 00 BC 04 BC 5B C0 18 80 37 81 77 0B
                39 00 11 E0 18 03 F0 1E F0 6E 01 63 00 DE 02 DE 2D 60 0C C0
                39 00 11 F0 3B C0 BB 05 8C 01 00 01 BF 1F 00 00 00 00 00 00
                39 00 03 50 5A 15
                39 00 11 80 00 00 00 00 00 00 00 00 00 00 00 00 00 00 00 00
                39 00 11 90 00 00 88 6A 06 8A 77 87 D0 6A 7F 71 E2 DD 21 B4
                39 00 11 A0 5A 00 00 00 00 00 00 00 00 00 00 00 00 00 00 00
                39 00 11 B0 00 00 00 00 00 00 00 C0 10 06 00 10 18 55 85 20
                39 00 11 C0 8A 5A D7 30 04 41 86 41 10 82 00 80 75 5D 57 49
                39 00 11 D0 B2 2C 55 0D 43 10 14 04 C3 50 14 C7 59 57 55 95
                39 00 11 E0 24 CB 5A D7 30 04 41 C7 51 14 C3 10 84 75 5D 57
                39 00 11 F0 08 A2 28 55 0D 43 10 04 00 82 40 10 86 59 57 00
                39 00 03 50 5A 16
                39 00 11 80 00 00 00 00 00 00 00 00 00 00 00 00 00 00 00 00
                39 00 07 90 00 00 00 00 D0 40
                39 00 03 50 5A 18
                39 00 11 80 EF BD F7 DE 7B EF BD 07 08 08 0A 0C 0C 0C 0C 0C
                39 00 11 90 0C 0C 0C 5C 09 A8 AA AA AA AA AA AA AA AA AA 5A
                39 00 11 A0 59 59 59 59 59 59 59 59 59 59 59 09 04 FF 05 80
                39 00 10 B0 80 00 04 20 00 01 08 40 00 02 10 80 00 04 0F
                39 00 03 50 5A 19
                39 00 11 80 F0 D9 C8 BA AF A6 9E 98 92 8D 88 84 00 F0 6F F6
                39 00 11 90 CF FC 6F F6 FE FC 0A FF AF B5 71 0E 6C 4A 69 08
                39 00 08 A0 00 00 00 00 00 00 00
                39 00 03 50 5A 1A
                39 00 11 80 00 04 08 0C 00 10 14 18 1C 00 20 28 30 38 00 40
                39 00 11 90 48 50 58 00 60 68 70 78 00 80 88 90 98 00 A0 A8
                39 00 11 A0 B0 B8 00 C0 C8 D0 D8 00 E0 E8 F0 F8 00 FC FE FF
                39 00 11 B0 00 00 04 08 0C 00 10 14 18 1C 00 20 28 30 38 00
                39 00 11 C0 40 48 50 58 00 60 68 70 78 00 80 88 90 98 00 A0
                39 00 11 D0 A8 B0 B8 00 C0 C8 D0 D8 00 E0 E8 F0 F8 00 FC FE
                39 00 11 E0 FF 00 00 04 08 0C 00 10 14 18 1C 00 20 28 30 38
                39 00 11 F0 00 40 48 50 58 00 60 68 70 78 00 80 88 90 98 00
                39 00 03 50 5A 1B
                39 00 11 80 A0 A8 B0 B8 00 C0 C8 D0 D8 00 E0 E8 F0 F8 00 FC
                39 00 05 90 FE FF 00 00
                39 00 03 50 5A 20
                39 00 08 80 7C 00 00 00 00 00 00
                39 00 03 50 5A 22
                39 00 0E 80 2D D3 00 41 10 04 41 10 04 41 10 1E 00
                39 00 03 50 5A 23
                39 00 11 80 01 05 00 05 00 00 00 00 00 00 00 00 00 00 00 00
                39 00 0A 90 FF 0F 00 00 00 00 00 00 00
                39 00 03 50 5A 24
                39 00 11 80 00 03 00 9D BF 10 00 00 00 00 00 00 00 00 DE 1C
                15 00 02 90 A5
                39 00 03 50 5A 2F
                15 00 02 09 01
		05 96 01 11
		05 32 01 29 				
		];*/
panel-init-sequence = [
				15 00 02 E0 00
				15 00 02 E1 93
				15 00 02 E2 65
				15 00 02 E3 F8
				15 00 02 80 03
				15 00 02 E0 01
				15 00 02 00 00
				15 00 02 01 30
				15 00 02 03 00
				15 00 02 04 3C
				15 00 02 0C 74
				15 00 02 17 00
				15 00 02 18 F7
				15 00 02 19 00
				15 00 02 1A 00
				15 00 02 1B F7
				15 00 02 1C 00
				15 00 02 24 FE
				15 00 02 35 23
				15 00 02 37 09
				15 00 02 38 04
				15 00 02 39 00
				15 00 02 3A 01
				15 00 02 3C 70
				15 00 02 3D FF
				15 00 02 3E FF
				15 00 02 3F 7F
				15 00 02 40 06
				15 00 02 41 A0
				15 00 02 43 1E
				15 00 02 44 0B
				15 00 02 45 28
				15 00 02 55 02
				15 00 02 57 69
				15 00 02 59 0A
				15 00 02 5A 2D
				15 00 02 5B 1A
				15 00 02 5C 15
				15 00 02 5D 7F
				15 00 02 5E 6B
				15 00 02 5F 5C
				15 00 02 60 4F
				15 00 02 61 4B
				15 00 02 62 3D
				15 00 02 63 41
				15 00 02 64 2C
				15 00 02 65 46
				15 00 02 66 46
				15 00 02 67 46
				15 00 02 68 64
				15 00 02 69 50
				15 00 02 6A 55
				15 00 02 6B 47
				15 00 02 6C 43
				15 00 02 6D 36
				15 00 02 6E 27
				15 00 02 6F 26
				15 00 02 70 7F
				15 00 02 71 6B
				15 00 02 72 5C
				15 00 02 73 4F
				15 00 02 74 4B
				15 00 02 75 3D
				15 00 02 76 41
				15 00 02 77 2C
				15 00 02 78 46
				15 00 02 79 46
				15 00 02 7A 46
				15 00 02 7B 64
				15 00 02 7C 50
				15 00 02 7D 55
				15 00 02 7E 47
				15 00 02 7F 43
				15 00 02 80 36
				15 00 02 81 27
				15 00 02 82 11
				15 00 02 E0 02
				15 00 02 00 50
				15 00 02 01 5F
				15 00 02 02 5F
				15 00 02 03 52
				15 00 02 04 77
				15 00 02 05 57
				15 00 02 06 5F
				15 00 02 07 4E
				15 00 02 08 4C
				15 00 02 09 5F
				15 00 02 0A 4A
				15 00 02 0B 48
				15 00 02 0C 5F
				15 00 02 0D 46
				15 00 02 0E 44
				15 00 02 0F 40
				15 00 02 10 5F
				15 00 02 11 5F
				15 00 02 12 5F
				15 00 02 13 5F
				15 00 02 14 5F
				15 00 02 15 5F
				15 00 02 16 51
				15 00 02 17 5F
				15 00 02 18 5F
				15 00 02 19 53
				15 00 02 1A 77
				15 00 02 1B 57
				15 00 02 1C 5F
				15 00 02 1D 4F
				15 00 02 1E 4D
				15 00 02 1F 5F
				15 00 02 20 4B
				15 00 02 21 49
				15 00 02 22 5F
				15 00 02 23 47
				15 00 02 24 45
				15 00 02 25 41
				15 00 02 26 5F
				15 00 02 27 5F
				15 00 02 28 5F
				15 00 02 29 5F
				15 00 02 2A 5F
				15 00 02 2B 5F
				15 00 02 2C 01
				15 00 02 2D 1F
				15 00 02 2E 1F
				15 00 02 2F 13
				15 00 02 30 17
				15 00 02 31 17
				15 00 02 32 1F
				15 00 02 33 0D
				15 00 02 34 0F
				15 00 02 35 1F
				15 00 02 36 05
				15 00 02 37 07
				15 00 02 38 1F
				15 00 02 39 09
				15 00 02 3A 0B
				15 00 02 3B 11
				15 00 02 3C 1F
				15 00 02 3D 1F
				15 00 02 3E 1F
				15 00 02 3F 1F
				15 00 02 40 1F
				15 00 02 41 1F
				15 00 02 42 00
				15 00 02 43 1F
				15 00 02 44 1F
				15 00 02 45 12
				15 00 02 46 17
				15 00 02 47 17
				15 00 02 48 1F
				15 00 02 49 0C
				15 00 02 4A 0E
				15 00 02 4B 1F
				15 00 02 4C 04
				15 00 02 4D 06
				15 00 02 4E 1F
				15 00 02 4F 08
				15 00 02 50 0A
				15 00 02 51 10
				15 00 02 52 1F
				15 00 02 53 1F
				15 00 02 54 1F
				15 00 02 55 1F
				15 00 02 56 1F
				15 00 02 57 1F
				15 00 02 58 40
				15 00 02 5B 10
				15 00 02 5C 06
				15 00 02 5D 40
				15 00 02 5E 00
				15 00 02 5F 00
				15 00 02 60 40
				15 00 02 61 03
				15 00 02 62 04
				15 00 02 63 6C
				15 00 02 64 6C
				15 00 02 65 75
				15 00 02 66 08
				15 00 02 67 B4
				15 00 02 68 08
				15 00 02 69 6C
				15 00 02 6A 6C
				15 00 02 6B 0C
				15 00 02 6D 00
				15 00 02 6E 00
				15 00 02 6F 88
				15 00 02 75 BB
				15 00 02 76 00
				15 00 02 77 05
				15 00 02 78 2A
				15 00 02 E0 04
				15 00 02 00 0E
				15 00 02 02 B3
				15 00 02 09 60
				15 00 02 0E 48
				15 00 02 E0 00
				05 16 01 11
				05 78 01 29
		    ];
			
		panel-exit-sequence = [
			/*05 00 01 28
			05 00 01 10*/
		];
		disp_timings0: display-timings {
			native-mode = <&dsi0_timing0>;
			dsi0_timing0: timing0 {
				//clock-frequency = <50000000>;//gao liang
				clock-frequency = <68000000>;
				hactive = <800>;
				vactive = <1280>;
				hsync-len = <20>;
				hback-porch = <20>;
				hfront-porch = <20>;
				
				vsync-len = <4>;
				vback-porch = <8>;
				vfront-porch = <30>;
				
				hsync-active = <0>;
				vsync-active = <0>;
				de-active = <0>;
				pixelclk-active = <0>;
			};
		};	    
	};              
};        

