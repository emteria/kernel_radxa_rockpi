&dsi0 {
	status = "disabled";
	//rockchip,lane-rate = <1000>;
	
	dsi0_panel: panel@0 {
		status = "disabled";
		compatible = "simple-panel-dsi";
		reg = <0>;
		backlight = <&backlight>;
		
		prepare-delay-ms = <120>;
		reset-delay-ms = <120>;
		init-delay-ms = <120>;
		stbyb-delay-ms = <120>;
		enable-delay-ms = <120>;
		disable-delay-ms = <120>;
		unprepare-delay-ms = <120>;
		
		dsi,flags = <(MIPI_DSI_MODE_VIDEO | MIPI_DSI_MODE_VIDEO_BURST |
			MIPI_DSI_MODE_LPM | MIPI_DSI_MODE_EOT_PACKET)>;
		dsi,format = <MIPI_DSI_FMT_RGB888>;
		dsi,lanes  = <4>;
		panel-init-sequence = [
			15 01 02 E0 00
			15 01 02 E1 93
			15 01 02 E2 65
			15 01 02 E3 F8
			15 01 02 80 03
			15 01 02 E0 01
			15 01 02 00 00
			15 01 02 01 5C
			15 01 02 17 00
			15 01 02 18 D7
			15 01 02 19 01
			15 01 02 1A 00
			15 01 02 1B D7
			15 01 02 1C 01
			15 01 02 1F 70
			15 01 02 20 2D
			15 01 02 21 2D
			15 01 02 22 7E
			15 01 02 24 FD
			15 01 02 37 19
			15 01 02 35 28
			15 01 02 38 05
			15 01 02 39 08
			15 01 02 3A 12
			15 01 02 3C 7E
			15 01 02 3D FF
			15 01 02 3E FF
			15 01 02 3F 7F
			15 01 02 0C 74
			15 01 02 40 06
			15 01 02 41 A0
			15 01 02 43 1E
			15 01 02 44 0B
			15 01 02 55 01
			15 01 02 56 01
			15 01 02 57 6A
			15 01 02 58 09
			15 01 02 59 0A
			15 01 02 5A 2E
			15 01 02 5B 1A
			15 01 02 5C 15
			15 01 02 5D 7F
			15 01 02 5E 5D
			15 01 02 5F 4B
			15 01 02 60 3E
			15 01 02 61 3A
			15 01 02 62 2B
			15 01 02 63 2F
			15 01 02 64 19
			15 01 02 65 32
			15 01 02 66 31
			15 01 02 67 31
			15 01 02 68 4F
			15 01 02 69 3E
			15 01 02 6A 47
			15 01 02 6B 36
			15 01 02 6C 31
			15 01 02 6D 24
			15 01 02 6E 12
			15 01 02 6F 02
			15 01 02 70 7F
			15 01 02 71 5D
			15 01 02 72 4B
			15 01 02 73 3E
			15 01 02 74 3A
			15 01 02 75 2B
			15 01 02 76 2F
			15 01 02 77 19
			15 01 02 78 32
			15 01 02 79 31
			15 01 02 7A 31
			15 01 02 7B 4F
			15 01 02 7C 3E
			15 01 02 7D 47
			15 01 02 7E 36
			15 01 02 7F 31
			15 01 02 80 24
			15 01 02 81 12
			15 01 02 82 02
			15 01 02 E0 02
			15 01 02 00 52
			15 01 02 01 55
			15 01 02 02 55
			15 01 02 03 50
			15 01 02 04 77
			15 01 02 05 57
			15 01 02 06 55
			15 01 02 07 4E
			15 01 02 08 4C
			15 01 02 09 5F
			15 01 02 0A 4A
			15 01 02 0B 48
			15 01 02 0C 55
			15 01 02 0D 46
			15 01 02 0E 44
			15 01 02 0F 40
			15 01 02 10 55
			15 01 02 11 55
			15 01 02 12 55
			15 01 02 13 55
			15 01 02 14 55
			15 01 02 15 55
			15 01 02 16 53
			15 01 02 17 55
			15 01 02 18 55
			15 01 02 19 51
			15 01 02 1A 77
			15 01 02 1B 57
			15 01 02 1C 55
			15 01 02 1D 4F
			15 01 02 1E 4D
			15 01 02 1F 5F
			15 01 02 20 4B
			15 01 02 21 49
			15 01 02 22 55
			15 01 02 23 47
			15 01 02 24 45
			15 01 02 25 41
			15 01 02 26 55
			15 01 02 27 55
			15 01 02 28 55
			15 01 02 29 55
			15 01 02 2A 55
			15 01 02 2B 55
			15 01 02 2C 13
			15 01 02 2D 15
			15 01 02 2E 15
			15 01 02 2F 01
			15 01 02 30 37
			15 01 02 31 17
			15 01 02 32 15
			15 01 02 33 0D
			15 01 02 34 0F
			15 01 02 35 15
			15 01 02 36 05
			15 01 02 37 07
			15 01 02 38 15
			15 01 02 39 09
			15 01 02 3A 0B
			15 01 02 3B 11
			15 01 02 3C 15
			15 01 02 3D 15
			15 01 02 3E 15
			15 01 02 3F 15
			15 01 02 40 15
			15 01 02 41 15
			15 01 02 42 12
			15 01 02 43 15
			15 01 02 44 15
			15 01 02 45 00
			15 01 02 46 37
			15 01 02 47 17
			15 01 02 48 15
			15 01 02 49 0C
			15 01 02 4A 0E
			15 01 02 4B 15
			15 01 02 4C 04
			15 01 02 4D 06
			15 01 02 4E 15
			15 01 02 4F 08
			15 01 02 50 0A
			15 01 02 51 10
			15 01 02 52 15
			15 01 02 53 15
			15 01 02 54 15
			15 01 02 55 15
			15 01 02 56 15
			15 01 02 57 15
			15 01 02 58 40
			15 01 02 5B 10
			15 01 02 5C 06
			15 01 02 5D 40
			15 01 02 5E 00
			15 01 02 5F 00
			15 01 02 60 40
			15 01 02 61 03
			15 01 02 62 04
			15 01 02 63 6C
			15 01 02 64 6C
			15 01 02 65 75
			15 01 02 66 08
			15 01 02 67 B4
			15 01 02 68 08
			15 01 02 69 6C
			15 01 02 6A 6C
			15 01 02 6B 0C
			15 01 02 6D 00
			15 01 02 6E 00
			15 01 02 6F 88
			15 01 02 75 BB
			15 01 02 76 00
			15 01 02 77 05
			15 01 02 78 2A
			15 01 02 E0 04
			15 01 02 36 49
			15 01 02 09 11
			15 01 02 0E 48
			15 01 02 E0 00
			05 78 01 11
			05 1E 01 29
			15 01 02 35 00
			15 01 02 E0 00
		];

		panel-exit-sequence = [
			05 00 01 28
			05 00 01 10
		];

		disp_timings0: display-timings {
			native-mode = <&dsi0_timing0>;
			dsi0_timing0: timing0 {
				clock-frequency = <68000000>;
				hactive = <800>;
				vactive = <1280>;

				hsync-len = <20>;
				hback-porch = <20>;
				hfront-porch = <20>;

				vsync-len = <4>;
				vback-porch = <8>;
				vfront-porch = <30>;

				hsync-active = <0>;
				vsync-active = <0>;
				de-active = <0>;
				pixelclk-active = <0>;
			};
		};

	};

};