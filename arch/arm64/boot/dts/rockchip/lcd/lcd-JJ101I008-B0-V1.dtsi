&dsi0 {
	status = "disabled";
	//rockchip,lane-rate = <1000>;
	
	dsi0_panel: panel@0 {
		status = "disabled";
		compatible = "simple-panel-dsi";
		reg = <0>;
		backlight = <&backlight>;
		
		prepare-delay-ms = <120>;
		reset-delay-ms = <120>;
		init-delay-ms = <120>;
		stbyb-delay-ms = <120>;
		enable-delay-ms = <120>;
		disable-delay-ms = <120>;
		unprepare-delay-ms = <120>;
		
		dsi,flags = <(MIPI_DSI_MODE_VIDEO | MIPI_DSI_MODE_VIDEO_BURST |
			MIPI_DSI_MODE_LPM | MIPI_DSI_MODE_EOT_PACKET)>;
		dsi,format = <MIPI_DSI_FMT_RGB888>;
		dsi,lanes  = <4>;
		
		panel-init-sequence = [
			39 00 04 FF 98 81 03
			15 00 02 01 00 
			15 00 02 02 00 
			15 00 02 03 53 
			15 00 02 04 53 
			15 00 02 05 13 
			15 00 02 06 04 
			15 00 02 07 02 
			15 00 02 08 02 
			15 00 02 09 00 
			15 00 02 0a 00 
			15 00 02 0b 00 
			15 00 02 0c 00 
			15 00 02 0d 00 
			15 00 02 0e 00 
			15 00 02 0f 00 
			15 00 02 10 00 
			15 00 02 11 00 
			15 00 02 12 00 
			15 00 02 13 00 
			15 00 02 14 00 
			15 00 02 15 00 
			15 00 02 16 00 
			15 00 02 17 00 
			15 00 02 18 00 
			15 00 02 19 00 
			15 00 02 1a 00 
			15 00 02 1b 00 
			15 00 02 1c 00 
			15 00 02 1d 00 
			15 00 02 1e C0 //00
			15 00 02 1f 00 
			15 00 02 20 02 
			15 00 02 21 09 
			15 00 02 22 00 
			15 00 02 23 00 
			15 00 02 24 00 
			15 00 02 25 00 
			15 00 02 26 00 
			15 00 02 27 00 
			15 00 02 28 55 
			15 00 02 29 03 
			15 00 02 2a 00 
			15 00 02 2b 00 
			15 00 02 2c 00 
			15 00 02 2d 00 
			15 00 02 2e 00 
			15 00 02 2f 00 
			15 00 02 30 00 
			15 00 02 31 00 
			15 00 02 32 00 
			15 00 02 33 00 
			15 00 02 34 00 
			15 00 02 35 00 
			15 00 02 36 00 
			15 00 02 37 00 
			15 00 02 38 3c 
			15 00 02 39 00 
			15 00 02 3a 00 
			15 00 02 3b 00 
			15 00 02 3c 00 
			15 00 02 3d 00 
			15 00 02 3e 00 
			15 00 02 3f 00 
			15 00 02 40 00 
			15 00 02 41 00 
			15 00 02 42 00 
			15 00 02 43 00 
			15 00 02 44 00 
			15 00 02 45 00 
			
			15 00 02 50 01 
			15 00 02 51 23 
			15 00 02 52 45 
			15 00 02 53 67 
			15 00 02 54 89 
			15 00 02 55 ab 
			15 00 02 56 01 
			15 00 02 57 23 
			15 00 02 58 45 
			15 00 02 59 67 
			15 00 02 5a 89 
			15 00 02 5b ab 
			15 00 02 5c cd 
			15 00 02 5d ef
			
			15 00 02 5e 01 
			15 00 02 5f 0A 
			15 00 02 60 02 
			15 00 02 61 02 
			15 00 02 62 08 
			15 00 02 63 15 
			15 00 02 64 14 
			15 00 02 65 02 
			15 00 02 66 11 
			15 00 02 67 10 
			15 00 02 68 02 
			15 00 02 69 0F 
			15 00 02 6a 0E 
			15 00 02 6b 02 
			15 00 02 6c 0D 
			15 00 02 6d 0C 
			15 00 02 6e 06 
			15 00 02 6f 02 
			15 00 02 70 02 
			15 00 02 71 02 
			15 00 02 72 02 
			15 00 02 73 02 
			15 00 02 74 02
			
			15 00 02 75 0A 
			15 00 02 76 02 
			15 00 02 77 02 
			15 00 02 78 06 
			15 00 02 79 15 
			15 00 02 7a 14 
			15 00 02 7b 02 
			15 00 02 7c 10 
			15 00 02 7d 11 
			15 00 02 7e 02 
			15 00 02 7f 0c 
			15 00 02 80 0d //0d
			15 00 02 81 02 
			15 00 02 82 0E 
			15 00 02 83 0F 
			15 00 02 84 08 
			15 00 02 85 02 
			15 00 02 86 02 
			15 00 02 87 02 
			15 00 02 88 02 
			15 00 02 89 02 
			15 00 02 8a 02
			
			39 00 04 FF 98 81 04 
			//15 00 02 3B C0 
			15 00 02 6C 15 
			15 00 02 6E 30 
			15 00 02 6F 55 //55 
			15 00 02 3A 24 
			15 00 02 8D 1F 
			15 00 02 87 BA 
			15 00 02 26 76 
			15 00 02 B2 D1 
			15 00 02 B5 07 
			15 00 02 35 1f
			15 00 02 31 75
			15 00 02 3b 98
			15 00 02 38 01 
			15 00 02 39 00
			15 00 02 88 0b
			//15 00 02 2F 01   
			39 00 04 FF 98 81 01 
			15 00 02 22 0a 
			15 00 02 31 09 
			15 00 02 35 07
			//15 00 02 40 33 
			15 00 02 53 48
			15 00 02 40 33
			15 00 02 55 88 
			15 00 02 50 95 
			15 00 02 51 95 
			15 00 02 60 30
			15 00 02 34 01
			
			15 00 02 A0 0f 
			15 00 02 A1 17 
			15 00 02 A2 22 
			15 00 02 A3 19 
			15 00 02 A4 15 
			15 00 02 A5 28 
			15 00 02 A6 1C 
			15 00 02 A7 1C 
			15 00 02 A8 78 
			15 00 02 A9 1C 
			15 00 02 AA 28 
			15 00 02 AB 69 
			15 00 02 AC 1A 
			15 00 02 AD 19 
			15 00 02 AE 4B 
			15 00 02 AF 22 
			15 00 02 B0 2A 
			15 00 02 B1 4B 
			15 00 02 B2 6B 
			15 00 02 B3 3F
			
			15 00 02 C0 01 
			15 00 02 C1 17 
			15 00 02 C2 22 
			15 00 02 C3 19 
			15 00 02 C4 15 
			15 00 02 C5 28 
			15 00 02 C6 1C 
			15 00 02 C7 1D 
			15 00 02 C8 78 
			15 00 02 C9 1C 
			15 00 02 CA 28 
			15 00 02 CB 69 
			15 00 02 CC 1A 
			15 00 02 CD 19 
			15 00 02 CE 4B 
			15 00 02 CF 22 
			15 00 02 D0 2A 
			15 00 02 D1 4B 
			15 00 02 D2 6B 
			15 00 02 D3 3F
			
			39 00 04 FF 98 81 00 
			15 00 02 35 00 
			05 78 01 11
			05 1E 01 29
		];

		panel-exit-sequence = [
			05 00 01 28
			05 00 01 10
		];

		disp_timings0: display-timings {
			native-mode = <&dsi0_timing0>;
			dsi0_timing0: timing0 {
				clock-frequency = <66000000>;
				hactive = <800>;
				vactive = <1280>;
				hsync-len = <20>;
				hback-porch = <30>;
				hfront-porch = <40>;
				
				vsync-len = <4>;
				vback-porch = <18>;
				vfront-porch = <8>;
				
				hsync-active = <0>;
				vsync-active = <0>;
				de-active = <0>;
				pixelclk-active = <0>;
			};
		};

	};

};