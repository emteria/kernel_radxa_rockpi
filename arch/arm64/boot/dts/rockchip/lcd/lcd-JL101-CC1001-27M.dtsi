&dsi0 {
	status = "disabled";
	//rockchip,lane-rate = <1000>;
	
	dsi0_panel: panel@0 {
		status = "disabled";
		compatible = "simple-panel-dsi";
		reg = <0>;
		backlight = <&backlight>;
		
		prepare-delay-ms = <120>;
		reset-delay-ms = <120>;
		init-delay-ms = <120>;
		stbyb-delay-ms = <120>;
		enable-delay-ms = <120>;
		disable-delay-ms = <120>;
		unprepare-delay-ms = <120>;
		
		dsi,flags = <(MIPI_DSI_MODE_VIDEO | MIPI_DSI_MODE_VIDEO_BURST |
			MIPI_DSI_MODE_LPM | MIPI_DSI_MODE_EOT_PACKET)>;
		dsi,format = <MIPI_DSI_FMT_RGB888>;
		dsi,lanes  = <4>;
		panel-init-sequence = [
		15 00 02 ee 50
		39 00 03 ea 85 55
		15 00 02 30 00
		15 00 02 22 00
		15 00 02 24 20
		15 00 02 25 00
		15 00 02 79 08
		15 00 02 7a 20
		15 00 02 80 10
		39 00 03 90 20 2a    //d0
		15 00 02 93 36
		15 00 02 95 74
		15 00 02 97 0a
		15 00 02 99 10
		15 00 02 ee 60
		15 00 02 21 01
		15 00 02 27 22
		15 00 02 2c f9
		15 00 02 29 8a
		15 00 02 30 01
		15 00 02 32 d9
		15 00 02 34 3f
		15 00 02 3b 00
		15 00 02 3c 22
		39 00 03 3d 03 85    //d0
		15 00 02 44 0a
		15 00 02 46 1f
		39 00 03 42 55 55    //d0
		15 00 02 7f 24
		15 00 02 80 24
		15 00 02 86 20
		15 00 02 89 11
		15 00 02 91 11
		15 00 02 92 33
		15 00 02 93 9f
		15 00 02 9a 00   //a
		39 00 03 9b 02 80    //d0
		39 00 06 47 15 29 39 45 4f
		39 00 06 5a 15 29 39 45 4f
		39 00 06 4c 5a 50 60 40 3e
		39 00 06 5f 5a 50 60 40 3e 
		39 00 06 51 3d 23 37 33 41
		39 00 06 64 3d 23 37 33 41 
		39 00 05 56 43 4f 5f 7f
		39 00 05 69 43 4f 5f 7f
		15 00 02 ee 70 
		39 00 05 00 05 09 00 01  
		39 00 05 04 05 09 55 01  
		39 00 05 08 09 0d 55 01
		39 00 03 0c 05 02      
		39 00 06 10 07 0b 00 00 00 
		39 00 05 15 00 0f 0d 0c  
		39 00 06 20 0e 13 00 00 00
		39 00 05 25 00 0f 0d 0c  
		39 00 03 29 05 02      
		39 00 06 30 0e 0f 55 05 05
		39 00 06 35 3c 0f 0e 55 05
		39 00 03 3a 05 3c
		15 00 02 45 01
		39 00 06 46 ff 00 00 00 50
		15 00 02 4b 88 
		39 00 06 60 08 3c 3c 04 21
		39 00 06 65 20 3c 1a 18 3c
		39 00 06 6a 16 14 3c 12 10
		39 00 06 6f 00 3c 3c 3c 3c
		39 00 03 74 3c 3c
		39 00 06 80 09 3c 3c 05 21
		39 00 06 85 20 3c 1b 19 3c
		39 00 06 8a 17 15 3c 13 11
		39 00 06 8f 01 3c 3c 3c 3c
		39 00 03 94 3c 3c
		39 00 03 ea 00 00
		15 00 02 ee 00
		05 20 01 11		
		05 25 01 29
		];

		disp_timings0: display-timings {
			native-mode = <&dsi0_timing0>;
			dsi0_timing0: timing0 {
                clock-frequency = <73000000>;//68000000   72000000
				hactive = <800>;
				vactive = <1280>;
				hsync-len = <20>;//8//5//8
				hback-porch = <20>;//32//59//90
				hfront-porch = <80>;//156//16//24
				
				vsync-len = <4>;//4
				vback-porch = <8>;//8
				vfront-porch = <20>;//20
				
				hsync-active = <0>;
				vsync-active = <0>;
				de-active = <0>;
				pixelclk-active = <0>;
			};
		};

	};

};