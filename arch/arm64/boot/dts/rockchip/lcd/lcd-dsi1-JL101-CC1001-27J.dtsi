&dsi1 {
	status = "disabled";
	//rockchip,lane-rate = <1000>;
	dsi1_panel: panel@0 {
		status = "disabled";
		compatible = "simple-panel-dsi";
		reg = <0>;
		//backlight = <&backlight1>;
		
		prepare-delay-ms = <120>;
		reset-delay-ms = <120>;
		init-delay-ms = <120>;
		stbyb-delay-ms = <120>;
		enable-delay-ms = <120>;
		disable-delay-ms = <120>;
		unprepare-delay-ms = <120>;
		
		dsi,flags = <(MIPI_DSI_MODE_VIDEO | MIPI_DSI_MODE_VIDEO_BURST |
			MIPI_DSI_MODE_LPM | MIPI_DSI_MODE_EOT_PACKET)>;
		dsi,format = <MIPI_DSI_FMT_RGB888>;
		dsi,lanes  = <4>;
		panel-init-sequence = [
			15 00 02 E0 00
			15 00 02 E1 93
			15 00 02 E2 65
			15 00 02 E3 F8
			15 00 02 80 03
			15 00 02 E0 01
			15 00 02 00 00
			15 00 02 01 30
			15 00 02 03 00
			15 00 02 04 36
			15 00 02 0C 74
			15 00 02 17 00
			15 00 02 18 D7		
			15 00 02 19 01
			15 00 02 1A 00
			15 00 02 1B D7
			15 00 02 1C 01
			15 00 02 25 30		
			15 00 02 24 FE
			15 00 02 37 19
			15 00 02 35 28
			15 00 02 38 05
			15 00 02 39 08
			15 00 02 3A 12
			15 00 02 3C 7E
			15 00 02 3D FF
			15 00 02 3E FF
			15 00 02 3F 7F
			15 00 02 40 06
			15 00 02 41 A0
			15 00 02 43 1E
			15 00 02 44 0B
			15 00 02 55 02	
			15 00 02 57 6A
			15 00 02 59 0A
			15 00 02 5A 2E
			15 00 02 5B 1A
			15 00 02 5C 15
			15 00 02 5D 7F
			15 00 02 5E 73
			15 00 02 5F 68
			15 00 02 60 5E		
			15 00 02 61 5D
			15 00 02 62 50
			15 00 02 63 55
			15 00 02 64 40
			15 00 02 65 59
			15 00 02 66 58		
			15 00 02 67 58
			15 00 02 68 73
			15 00 02 69 5C
			15 00 02 6A 5E
			15 00 02 6B 4C
			15 00 02 6C 42
			15 00 02 6D 31
			15 00 02 6E 1A
			15 00 02 6F 00
			15 00 02 70 7F
			15 00 02 71 73
			15 00 02 72 68
			15 00 02 73 5E		
			15 00 02 74 5D
			15 00 02 75 50
			15 00 02 76 55
			15 00 02 77 40		
			15 00 02 78 59
			15 00 02 79 58
			15 00 02 7A 58
			15 00 02 7B 73
			15 00 02 7C 5C		
			15 00 02 7D 5E
			15 00 02 7E 4C
			15 00 02 7F 42
			15 00 02 80 31
			15 00 02 81 1A		
			15 00 02 82 00
			15 00 02 E0 02
			15 00 02 00 52
			15 00 02 01 5F
			15 00 02 02 5F
			15 00 02 03 50
			15 00 02 04 77
			15 00 02 05 57		
			15 00 02 06 5F
			15 00 02 07 4E
			15 00 02 08 4C
			15 00 02 09 5F
			15 00 02 0A 4A
			15 00 02 0B 48
			15 00 02 0C 5F		
			15 00 02 0D 46
			15 00 02 0E 44
			15 00 02 0F 40
			15 00 02 10 5F
			15 00 02 11 5F
			15 00 02 12 5F		
			15 00 02 13 5F
			15 00 02 14 5F
			15 00 02 15 5F
			15 00 02 16 53
			15 00 02 17 5F
			15 00 02 18 5F
			15 00 02 19 51		
			15 00 02 1A 77
			15 00 02 1B 57
			15 00 02 1C 5F
			15 00 02 1D 4F
			15 00 02 1E 4D
			15 00 02 1F 5F
			15 00 02 20 4B		
			15 00 02 21 49
			15 00 02 22 5F
			15 00 02 23 47
			15 00 02 24 45
			15 00 02 25 41
			15 00 02 26 5F		
			15 00 02 27 5F
			15 00 02 28 5F
			15 00 02 29 5F
			15 00 02 2A 5F		
			15 00 02 2B 5F
			15 00 02 2C 13
			15 00 02 2D 1F
			15 00 02 2E 1F
			15 00 02 2F 01
			15 00 02 30 17				
			15 00 02 31 17
			15 00 02 32 1F
			15 00 02 33 0D
			15 00 02 34 0F
			15 00 02 35 1F
			15 00 02 36 05
			15 00 02 37 07		
			15 00 02 38 1F
			15 00 02 39 09
			15 00 02 3A 0B
			15 00 02 3B 11
			15 00 02 3C 1F
			15 00 02 3D 1F
			15 00 02 3E 1F
			15 00 02 3F 1F
			15 00 02 40 1F
			15 00 02 41 1F
			15 00 02 42 12
			15 00 02 43 1F
			15 00 02 44 1F
			15 00 02 45 00
			15 00 02 46 17
			15 00 02 47 17
			15 00 02 48 1F
			15 00 02 49 0C
			15 00 02 4A 0E
			15 00 02 4B 1F
			15 00 02 4C 04
			15 00 02 4D 06
			15 00 02 4E 1F
			15 00 02 4F 08
			15 00 02 50 0A
			15 00 02 51 10
			15 00 02 52 1F
			15 00 02 53 1F
			15 00 02 54 1F
			15 00 02 55 1F
			15 00 02 56 1F
			15 00 02 57 1F
			15 00 02 58 40
			15 00 02 5B 10
			15 00 02 5C 06
			15 00 02 5D 40
			15 00 02 5E 00
			15 00 02 5F 00		
			15 00 02 60 40
			15 00 02 61 03
			15 00 02 62 04
			15 00 02 63 6C
			15 00 02 64 6C
			15 00 02 65 75
			15 00 02 66 08
			15 00 02 67 B4
			15 00 02 68 08
			15 00 02 69 6C
			15 00 02 6A 6C
			15 00 02 6B 0C
			15 00 02 6D 00
			15 00 02 6E 00
			15 00 02 6F 88
			15 00 02 75 BB
			15 00 02 76 00
			15 00 02 77 05
			15 00 02 78 2A		
			15 00 02 E0 04
			15 00 02 02 23
			15 00 02 09 11
			15 00 02 0E 4A
			15 00 02 36 49
			15 00 02 E0 00
			05 78 01 11
			05 14 01 29
		];

		panel-exit-sequence = [
			/*05 00 01 28
			05 00 01 10*/
		];

		disp_timings1: display-timings {
			native-mode = <&dsi1_timing0>;
			dsi1_timing0: timing0 {
				clock-frequency = <66000000>;
				hactive = <800>;
				vactive = <1280>;
				hsync-len = <20>;
				hback-porch = <30>;
				hfront-porch = <40>;
				
				vsync-len = <4>;
				vback-porch = <18>;
				vfront-porch = <8>;
				
				hsync-active = <0>;
				vsync-active = <0>;
				de-active = <0>;
				pixelclk-active = <0>;
			};
		};

	};

};