/dts-v1/;

#include "rk3566-rock-cm3io.dts"

&display_subsystem {
    route {
        route_hdmi: route-hdmi {
            logo,uboot = "logo_black.bmp";
            logo,kernel = "logo_black.bmp";
        };
    };
};
