// SPDX-License-Identifier: (GPL-2.0+ OR MIT)
/*
 * Copyright (c) 2020 Rockchip Electronics Co., Ltd.
 *
 */


#include "rk3568-radxa-cm3i.dtsi"
#include "rk3568-android.dtsi"

/ {
	model = "Rockchip RK3568 CM3i Board";
	compatible = "rockchip,rk3568-radxa-cm3i", "rockchip,rk3568";
};
