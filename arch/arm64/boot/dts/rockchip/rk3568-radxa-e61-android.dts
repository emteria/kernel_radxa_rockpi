// SPDX-License-Identifier: (GPL-2.0+ OR MIT)
/*
 * Copyright (c) 2020 Rockchip Electronics Co., Ltd.
 *
 */

#include "rk3568-radxa-e61.dtsi"
#include "rk3568-android.dtsi"

/ {
	model = "Rockchip RK3568 E61 Board";
	compatible = "rockchip,rk3568-radxa-e61", "rockchip,rk3568";
};