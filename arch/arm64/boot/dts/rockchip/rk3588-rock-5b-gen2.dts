// SPDX-License-Identifier: (GPL-2.0+ OR MIT)
/*
 * Copyright (c) 2021 Rockchip Electronics Co., Ltd.
 *
 */

/dts-v1/;

#include "rk3588-rock-5b-gen2-x10.dtsi"
//#include "rk3588-rock-5b-gen2-display-8hd.dtsi"
//#include "rk3588-rock-5b-gen2-display-10hd.dtsi"
#include "rk3588-rock-5b-gen2-display-10fhd.dtsi"
#include "rk3588-radxa-rock5b-gen2-imx415.dtsi"
#include "rk3588-android.dtsi"

/ {
	model = "Radxa ROCK 5B GEN2";
	compatible = "radxa,rock-5b", "rockchip,rk3588-evb1-lp4-v10", "rockchip,rk3588";
};
